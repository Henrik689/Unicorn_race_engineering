/**
* @file isr.c
* @brief
*	Interrupt service routine
*	
*/

#include "config.h"
#include "extern.h"
#include "prototyper.h"
#include <avr/io.h>
#include <stdlib.h>
#include <avr/interrupt.h>
#include <util/delay.h>


ISR(ADC_vect,ISR_NOBLOCK)
{
	unsigned int adlow = 0,adhigh = 0;
    unsigned int ADCconv;
    gearPositionOld = gearPosition;
    
	// Read the ADC data register (By default the ADC is RIGHT AJUSTED)
    adlow = ADCL;                                                       // ADCL is the least significant byte in the ADC data register
    adhigh = ADCH;                                                      // ADSH is the most significant byte in the ADC data register
	ADCconv = (unsigned int)((adhigh<<8)|(adlow & 0xFF));               // Assemble the two ADC data registers to a 10 bit value (ADCconv = ADCH + ADCL)
    
    gearPosition = ADCconv;
}


ISR(TIMER0_OVF_vect)
{
    gearButActive = 0;
    //servoCheck();
    gearBut = gearButCAN;
    gearButNeuMeas = GEARNEUTRALMEAS;
    
    // Conditions for when to set the estimated gear value up or down
    if((gearBut == GEARUPBUT) && (gearButNeuMeas == 0)){
        if(GearEst_val < 6){
            GearEst_val++;
        }
    }else if((gearBut == GEARDOWNBUT) && (gearButNeuMeas == 0)){
        if(GearEst_val > 1){
            GearEst_val--;
        }
    }else if((gearBut == GEARUPBUT) && (gearButNeuMeas == 1)){    // Conditions for when to gear down to 1 or up to gear 2 from neutral gear
        GearEst_val = 1;
    }else if((gearBut == GEARDOWNBUT) && (gearButNeuMeas == 1)){
        GearEst_val = 2;
    }
    
    //  Check if the gear should gear up half a gear from 1 to neutral
    if(gearButActive == 0 && (gearBut == GEARNEUBUT1)){
       
        gearButActive = 1;
        gearNeutral1();
        GearEst_val = 0;
    
    }else if(gearButActive == 0 && (gearBut == GEARNEUBUT2)){		    //  Check if the gear should gear down half a gear from 2 to neutral

        gearButActive = 1;
        gearNeutral2();
        GearEst_val = 0;
    
    }else if(gearButActive == 0 && gearBut == GEARUPBUT){ 		//  Check if gear should gear Up or Down
    
        gearButActive = 1;
        gearUp();
    
    }else if(gearButActive == 0 && gearBut == GEARDOWNBUT){
    
        gearButActive = 1;
        gearDown();
    }

        gearButCAN = 0;
}
